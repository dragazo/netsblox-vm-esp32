## sdkconfig.defaults
```kconfig
# Workaround for https://github.com/espressif/esp-idf/issues/7631
#CONFIG_MBEDTLS_CERTIFICATE_BUNDLE=n
#CONFIG_MBEDTLS_CERTIFICATE_BUNDLE_DEFAULT_FULL=n

# enable verbose logging
#CONFIG_LOG_DEFAULT_LEVEL_VERBOSE=y
#CONFIG_LOG_MAXIMUM_LEVEL_VERBOSE=y

# -----------------------------------------------------------

# Use this to set FreeRTOS kernel tick frequency to 1000 Hz (100 Hz by default).
# This allows to use 1 ms granularity for thread sleeps (10 ms by default).
CONFIG_FREERTOS_HZ=1000

# -----------------------------------------------------------

# rust needs more stack storage than C, so override it
CONFIG_ESP_MAIN_TASK_STACK_SIZE=20000

# disable idle watchdog for main task (to avoid non-yielding user code from triggering the watchdog)
CONFIG_ESP_TASK_WDT_CHECK_IDLE_TASK_CPU0=n

# -----------------------------------------------------------

# enable https servers (client works by default)
CONFIG_ESP_HTTPS_SERVER_ENABLE=y

# chrome sends extra long headers, so add more space for headers
CONFIG_HTTPD_MAX_REQ_HDR_LEN=1024

# -----------------------------------------------------------

# we don't want to have a cert for each server we connect to (local deployments, etc.), so skip server verification
CONFIG_ESP_TLS_INSECURE=y
CONFIG_ESP_TLS_SKIP_SERVER_CERT_VERIFY=y

# -----------------------------------------------------------

# these settings together successfully enable the 8MB external RAM chip
CONFIG_ESP32S3_SPIRAM_SUPPORT=y
CONFIG_SPIRAM_MODE_OCT=y

# malloc with spi ram and try to preserve as much internal memory as possible for system tasks
CONFIG_SPIRAM_USE_MALLOC=y
CONFIG_SPIRAM_MALLOC_RESERVE_INTERNAL=262144
CONFIG_SPIRAM_TRY_ALLOCATE_WIFI_LWIP=y

# -----------------------------------------------------------

# these fix nvs not working with spi flash enabled
CONFIG_ESPTOOLPY_OCT_FLASH=y
CONFIG_ESPTOOLPY_FLASH_SAMPLE_MODE_STR=y
```
